// SPDX-License-Identifier: GPL-2.0
/*
 * Device Tree Source for the PlayStation Vita 2000
 */

/dts-v1/;

#include <dt-bindings/gpio/gpio.h>
#include <dt-bindings/leds/common.h>
#include <dt-bindings/interrupt-controller/arm-gic.h>
#include <dt-bindings/clock/vita-pervasive.h>
#include "vita.dtsi"

/ {
	chosen {
		bootargs = "earlyprintk keep_bootcon console=tty0";

		framebuffer0: framebuffer@20000000 {
			compatible = "simple-framebuffer";
			reg = <0x20000000 (960*544*4)>;
			width = <960>;
			height = <544>;
			stride = <(960*4)>;
			format = "a8b8g8r8";
			status = "okay";
		};
	};
};

/* Handheld display uses DSI bus 0. */
&pervasive_clk {
	vita,clock-gate-indices = <VITA_PCLK_DSI0 VITA_PCLK_GPIO
				    VITA_PCLK_SPI0 VITA_PCLK_UART0
				    VITA_PCLK_MSIF>;
};
