## Documentation/devicetree/bindings/usb/vita,pstv-ohci.yaml
```yaml
# SPDX-License-Identifier: (GPL-2.0-only OR BSD-2-Clause)
%YAML 1.2
---
$id: http://devicetree.org/schemas/usb/vita,pstv-ohci.yaml#
$schema: http://devicetree.org/meta-schemas/core.yaml#

title: PlayStation TV native OHCI companion controller

maintainers:
  - Vita Linux maintainers <linux-vita@lists.example.org>

description: |
  The PlayStation TV has a native OHCI 1.0 full-/low-speed companion
  controller alongside its EHCI controller.  The companion is linked to the
  already-running EHCI host through vita,ehci.  The production driver uses
  the address and interrupt supplied by firmware and performs an identity
  check against the known PSTV hardware values.

properties:
  compatible:
    const: vita,pstv-ohci

  reg:
    maxItems: 1

  interrupts:
    maxItems: 1

  vita,ehci:
    description: Phandle to the paired EHCI host controller.
    $ref: /schemas/types.yaml#/definitions/phandle

  status: true

required:
  - compatible
  - reg
  - interrupts
  - vita,ehci

additionalProperties: false

examples:
  - |
    ohci0: ohci@e40e0200 {
        compatible = "vita,pstv-ohci";
        reg = <0xe40e0200 0x100>;
        interrupts = <GIC_SPI 113 IRQ_TYPE_LEVEL_HIGH>;
        vita,ehci = <&ehci0>;
        status = "disabled";
    };
```

## arch/arm/configs/vita_defconfig
```kconfig
CONFIG_NAMESPACES=y
CONFIG_BLK_DEV_INITRD=y
CONFIG_INITRAMFS_SOURCE="rootfs.cpio.zst"
# CONFIG_RD_BZIP2 is not set
# CONFIG_RD_LZMA is not set
# CONFIG_RD_LZO is not set
# CONFIG_RD_LZ4 is not set
CONFIG_INITRAMFS_COMPRESSION_NONE=y
CONFIG_EXPERT=y
# CONFIG_ARM_PATCH_PHYS_VIRT is not set
CONFIG_PHYS_OFFSET=0x41000000
# CONFIG_ARCH_MULTIPLATFORM is not set
CONFIG_ARCH_VITA=y
# CONFIG_ARM_ERRATA_643719 is not set
CONFIG_SMP=y
# CONFIG_SMP_ON_UP is not set
CONFIG_ZBOOT_ROM_TEXT=0
CONFIG_ZBOOT_ROM_BSS=0
# CONFIG_AUTO_ZRELADDR is not set
CONFIG_VFP=y
CONFIG_NEON=y
CONFIG_KERNEL_MODE_NEON=y
# CONFIG_SECCOMP is not set
# CONFIG_IOSCHED_BFQ is not set
CONFIG_CMA=y
CONFIG_CMA_AREAS=7
CONFIG_NET=y
CONFIG_PACKET=y
CONFIG_UNIX=y
CONFIG_INET=y
# CONFIG_WIRELESS is not set
CONFIG_DEVTMPFS=y
CONFIG_DEVTMPFS_MOUNT=y
CONFIG_BLK_DEV_NULL_BLK=y
CONFIG_INPUT_FF_MEMLESS=y
CONFIG_INPUT_MOUSEDEV=y
CONFIG_INPUT_JOYDEV=y
CONFIG_INPUT_EVDEV=y
# CONFIG_KEYBOARD_ATKBD is not set
# CONFIG_MOUSE_PS2 is not set
CONFIG_INPUT_JOYSTICK=y
CONFIG_JOYSTICK_VITA_BUTTONS=y
CONFIG_INPUT_TOUCHSCREEN=y
CONFIG_TOUCHSCREEN_VITA_SYSCON=y
CONFIG_SERIO_LIBPS2=y
CONFIG_SERIAL_VITA_UART=y
CONFIG_SERIAL_VITA_UART_CONSOLE=y
CONFIG_SPI=y
CONFIG_SPI_VITA=y
CONFIG_GPIOLIB=y
CONFIG_GPIO_SYSFS=y
CONFIG_GPIO_VITA=y
# CONFIG_HWMON is not set
CONFIG_FB=y
CONFIG_FB_SIMPLE=y
CONFIG_FRAMEBUFFER_CONSOLE=y
CONFIG_FRAMEBUFFER_CONSOLE_DETECT_PRIMARY=y
CONFIG_HIDRAW=y
# CONFIG_USB_SUPPORT is not set
CONFIG_MMC=y
CONFIG_MMC_DEBUG=y
CONFIG_MMC_SDHCI=y
CONFIG_MMC_SDHCI_VITA=y
CONFIG_NEW_LEDS=y
CONFIG_LEDS_CLASS=y
CONFIG_LEDS_GPIO=y
CONFIG_LEDS_TRIGGERS=y
CONFIG_LEDS_TRIGGER_HEARTBEAT=y
CONFIG_LEDS_TRIGGER_CPU=y
CONFIG_LEDS_TRIGGER_ACTIVITY=y
CONFIG_RTC_CLASS=y
CONFIG_RTC_DRV_VITA=y
# CONFIG_VIRTIO_MENU is not set
# CONFIG_IOMMU_SUPPORT is not set
CONFIG_RESET_CONTROLLER=y
CONFIG_TMPFS=y
CONFIG_TMPFS_POSIX_ACL=y
CONFIG_LSM="yama,loadpin,safesetid,integrity"
CONFIG_INIT_STACK_NONE=y
# CONFIG_FTRACE is not set
CONFIG_DEBUG_LL=y
CONFIG_DEBUG_UNCOMPRESS=y
CONFIG_EARLY_PRINTK=y
```

## drivers/gpu/drm/vita/Kconfig
```kconfig
# SPDX-License-Identifier: GPL-2.0-only

config DRM_VITA_IFTU
	tristate "DRM support for the PS Vita / PS TV IFTU display controller"
	depends on DRM && (ARCH_VITA || COMPILE_TEST)
	select APERTURE_HELPERS
	select DRM_GEM_SHMEM_HELPER
	select DRM_KMS_HELPER
	help
	  DRM driver for the IFTU display controller found on the PS Vita and
	  PS TV (Dolce). Takes over the framebuffer already configured and
	  scanned out by the bare-metal Linux loader (vita-baremetal-linux-loader)
	  -- fixed inherited mode only in the first milestone, no hardware
	  modeset, no vblank IRQ yet. See
	  lab/gpu-re/DISPLAY-DRM-RESEARCH-2026-08-30.md in the vita-linux-research
	  tree for the full register map, milestone ladder, and hardware
	  citations this driver is built from.

	  If M is selected the module will be called vita_iftu.
```
